// SPDX-License-Identifier: BSD-3-Clause
/*
 * Copyright (c) Qualcomm Technologies, Inc. and/or its subsidiaries.
 */


&pcie0 {
	qcom,pcie-phy-ver = <99>;
	qcom,phy-debug-reg = <0x01CC 0x01D0 0x01D4 0x01D8 0x01DC
				0x01E0 0x01E4 0x01F8 0x0ED0 0x16D0
				0x0EDC 0x16DC 0x11E0 0x19E0 0x0A00
				0x1200 0x0A04 0x1204 0x0A08 0x1208
				0x0A0C 0x120C 0x0A10 0x1210 0x0A14
				0x1214 0x0A18 0x1218 0x0C20 0x1420
				0x0214 0x0218 0x021C 0x0220 0x0224
				0x0228 0x022C 0x0230 0x0234 0x0238
				0x023C 0x0600 0x0604>;
	qcom,phy-sequence = <0x0240 0x03 0x0
			0x00c0 0x01 0x0
			0x00cc 0x31 0x0
			0x00d0 0x01 0x0
			0x0060 0xff 0x0
			0x0064 0x06 0x0
			0x0000 0x4c 0x0
			0x0004 0x06 0x0
			0x00e0 0x90 0x0
			0x00e4 0x82 0x0
			0x00f4 0x07 0x0
			0x0070 0x02 0x0
			0x0010 0x02 0x0
			0x0074 0x16 0x0
			0x0014 0x16 0x0
			0x0078 0x36 0x0
			0x0018 0x36 0x0
			0x0110 0x08 0x0
			0x00bc 0x0e 0x0
			0x0120 0x42 0x0
			0x0080 0x0a 0x0
			0x0084 0x1a 0x0
			0x0020 0x14 0x0
			0x0024 0x34 0x0
			0x0088 0x82 0x0
			0x0028 0x68 0x0
			0x0090 0xab 0x0
			0x0094 0xea 0x0
			0x0098 0x02 0x0
			0x0030 0xab 0x0
			0x0034 0xaa 0x0
			0x0038 0x02 0x0
			0x0140 0x14 0x0
			0x0164 0x34 0x0
			0x003c 0x01 0x0
			0x001c 0x04 0x0
			0x0174 0x16 0x0
			0x01bc 0x0f 0x0
			0x0170 0xa0 0x0
			0x11a4 0x38 0x0
			0x10dc 0x11 0x0
			0x1160 0xbf 0x0
			0x1164 0xbf 0x0
			0x1168 0xb7 0x0
			0x116c 0xea 0x0
			0x115c 0x3f 0x0
			0x1174 0x5c 0x0
			0x1178 0x9c 0x0
			0x117c 0x1a 0x0
			0x1180 0x89 0x0
			0x1170 0xdc 0x0
			0x1188 0x94 0x0
			0x118c 0x5b 0x0
			0x1190 0x1a 0x0
			0x1194 0x89 0x0
			0x10cc 0xf0 0x0
			0x1008 0x09 0x0
			0x1014 0x05 0x0
			0x104c 0x08 0x0
			0x1050 0x08 0x0
			0x10d8 0x0f 0x0
			0x1118 0x1c 0x0
			0x10f8 0x07 0x0
			0x11f8 0x08 0x0
			0x0e84 0x15 0x0
			0x0e90 0x3f 0x0
			0x0ee4 0x02 0x0
			0x0e40 0x06 0x0
			0x0e3c 0x18 0x0
			0x02dc 0x05 0x0
			0x0388 0x77 0x0
			0x0398 0x0b 0x0
			0x03e0 0x0f 0x0
			0x060c 0x1d 0x0
			0x0614 0x07 0x0
			0x0620 0xc1 0x0
			0x0694 0x00 0x0
			0x03d0 0x8c 0x0
			0x1424 0x01 0x0
			0x1428 0x01 0x0
			0x0200 0x00 0x0
			0x0244 0x03 0x0>;
	qcom,vreg-0p9-voltage-level = <880000 880000 75200>;
	qcom,vreg-1p8-voltage-level = <1200000 1200000 18000>;
	vreg-1p8-supply = <&pm8350c_l10>;
};

&pcie1 {
	vreg-1p8-supply = <&pm8350c_l10>;
	qcom,link-speed-cap-offset = <3>;
	qcom,no-l0s-supported;
	qcom,pcie-phy-ver = <99>;
	qcom,phy-power-down-offset = <0x240>;
	qcom,phy-sequence = <0x0240 0x03 0x0
			0x00c0 0x01 0x0
			0x00cc 0x31 0x0
			0x00d0 0x01 0x0
			0x0060 0xff 0x0
			0x0064 0x06 0x0
			0x0000 0x4c 0x0
			0x0004 0x06 0x0
			0x00e0 0x90 0x0
			0x00e4 0x82 0x0
			0x00f4 0x07 0x0
			0x0070 0x02 0x0
			0x0010 0x02 0x0
			0x0074 0x16 0x0
			0x0014 0x16 0x0
			0x0078 0x36 0x0
			0x0018 0x36 0x0
			0x0110 0x08 0x0
			0x00bc 0x0e 0x0
			0x0120 0x42 0x0
			0x0080 0x0a 0x0
			0x0084 0x1a 0x0
			0x0020 0x14 0x0
			0x0024 0x34 0x0
			0x0088 0x82 0x0
			0x0028 0x68 0x0
			0x0090 0xab 0x0
			0x0094 0xea 0x0
			0x0098 0x02 0x0
			0x0030 0xab 0x0
			0x0034 0xaa 0x0
			0x0038 0x02 0x0
			0x0140 0x14 0x0
			0x0164 0x34 0x0
			0x003c 0x01 0x0
			0x001c 0x04 0x0
			0x0174 0x16 0x0
			0x01bc 0x0f 0x0
			0x0170 0xa0 0x0
			0x11a4 0x38 0x0
			0x10dc 0x11 0x0
			0x1160 0xbf 0x0
			0x1164 0xbf 0x0
			0x1168 0xb7 0x0
			0x116c 0xea 0x0
			0x115c 0x3f 0x0
			0x1174 0x5c 0x0
			0x1178 0x9c 0x0
			0x117c 0x1a 0x0
			0x1180 0x89 0x0
			0x1170 0xdc 0x0
			0x1188 0x94 0x0
			0x118c 0x5b 0x0
			0x1190 0x1a 0x0
			0x1194 0x89 0x0
			0x10cc 0xf0 0x0
			0x1008 0x09 0x0
			0x1014 0x05 0x0
			0x104c 0x08 0x0
			0x1050 0x08 0x0
			0x10d8 0x0f 0x0
			0x1118 0x1c 0x0
			0x10f8 0x07 0x0
			0x11f8 0x08 0x0
			0x0e84 0x15 0x0
			0x0e90 0x3f 0x0
			0x0ee4 0x02 0x0
			0x0e40 0x06 0x0
			0x0e3c 0x18 0x0
			0x19a4 0x38 0x0
			0x18dc 0x11 0x0
			0x1960 0xbf 0x0
			0x1964 0xbf 0x0
			0x1968 0xb7 0x0
			0x196c 0xea 0x0
			0x195c 0x3f 0x0
			0x1974 0x5c 0x0
			0x1978 0x9c 0x0
			0x197c 0x1a 0x0
			0x1980 0x89 0x0
			0x1970 0xdc 0x0
			0x1988 0x94 0x0
			0x198c 0x5b 0x0
			0x1990 0x1a 0x0
			0x1994 0x89 0x0
			0x18cc 0xf0 0x0
			0x1808 0x09 0x0
			0x1814 0x05 0x0
			0x184c 0x08 0x0
			0x1850 0x08 0x0
			0x18d8 0x0f 0x0
			0x1918 0x1c 0x0
			0x18f8 0x07 0x0
			0x19f8 0x08 0x0
			0x1684 0x15 0x0
			0x1690 0x3f 0x0
			0x16e4 0x02 0x0
			0x1640 0x06 0x0
			0x163c 0x18 0x0
			0x02dc 0x05 0x0
			0x0388 0x77 0x0
			0x0398 0x0b 0x0
			0x03e0 0x0f 0x0
			0x060c 0x1d 0x0
			0x0614 0x07 0x0
			0x0620 0xc1 0x0
			0x0694 0x00 0x0
			0x03d0 0x8c 0x0
			0x1424 0x00 0x0
			0x1428 0x00 0x0
			0x0200 0x00 0x0
			0x0244 0x03 0x0>;
	qcom,phy-status-bit = <6>;
	qcom,phy-status-offset = <0x214>;
	qcom,vreg-0p9-voltage-level = <880000 880000 188000>;
	qcom,vreg-1p8-voltage-level = <1200000 1200000 25900>;
	qcom,vreg-qref-voltage-level = <880000 880000 1300>;
	vreg-1p8-supply = <&pm8350c_l10>;

	status = "disabled";
};

&pcie1_msi {
	status = "disabled";
};
