// SPDX-License-Identifier: BSD-3-Clause
/*
 * Copyright (c) Qualcomm Technologies, Inc. and/or its subsidiaries.
 */

&pm8008i_active {
	config {
		pins = "gpio6";
	};

	mux {
		pins = "gpio6";
	};
};
