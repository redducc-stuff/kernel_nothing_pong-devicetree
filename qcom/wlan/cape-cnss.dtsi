// SPDX-License-Identifier: BSD-3-Clause
// SPDX-FileCopyrightText: 2026 The PenguinOS Project

#include "waipio-qca6490-cnss.dtsi"

&soc {
	mhi_qrtr_cnss {
		compatible = "qcom,qrtr-mhi";
		qcom,dev-id = <0x1103>;
		qcom,net-id = <0>;
		qcom,low-latency;
	};
};

&wlan {
	qcom,bus-bw-cfg =
	/** ICC Path 1 **/
	<0 0>, /* no vote */
	/* idle: 0-18 Mbps snoc/anoc: 100 Mhz ddr: 451.2 MHz */
	<2250 1600000>,
	/* low: 18-60 Mbps snoc/anoc: 100 Mhz ddr: 451.2 MHz */
	<7500 1600000>,
	/* medium: 60-240 Mbps snoc/anoc: 100 Mhz ddr: 451.2 MHz */
	<30000 1600000>,
	/* high: 240-1200 Mbps snoc/anoc: 100 Mhz ddr: 451.2 MHz */
	<100000 1600000>,
	/* very high: > 1200 Mbps snoc/anoc: 403 Mhz ddr: 1555 MHz */
	<175000 6448000>,
	/* ultra high: DBS mode snoc/anoc: 403 Mhz ddr: 2092 MHz */
	<175000 6448000>,
	/* super high: DBS mode snoc/anoc: 533 Mhz ddr: 3.2GHz */
	<175000 8528000>,
	/* low (latency critical): 18-60 Mbps snoc/anoc: 200 Mhz
	 * ddr: 547.2 MHz
	 */
	<7500 3200000>,

	/** ICC Path 2 **/
	<0 0>,
	/* ddr: 451.2 MHz */
	<2250 1804800>,
	/* ddr: 451.2 MHz */
	<7500 1804800>,
	/* ddr: 451.2 MHz */
	<30000 1804800>,
	/* ddr: 451.2 MHz */
	<100000 1804800>,
	/* ddr: 1555 MHz */
	<175000 6220800>,
	/* ddr: 2092 MHz */
	<175000 8368000>,
	/* ddr: 3.2 GHz */
	<175000 12800000>,
	/* ddr: 547.2 MHz */
	<7500 2188800>;

	vdd-wlan-ipa-supply = <&S3E>;

	qcom,vdd-wlan-aon-config = <1012000 1040000 0 0 1>;
	qcom,vdd-wlan-dig-config = <966000 1170000 0 0 1>;
	qcom,vdd-wlan-ipa-config = <2200000 2200000 0 0 0>;
	qcom,vdd-wlan-rfa1-config = <1900000 2024000 0 0 1>;
	qcom,vdd-wlan-rfa2-config = <1350000 2040000 0 0 1>;
};
